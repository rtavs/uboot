## arch/arm/mach-meson/Kconfig
```kconfig
if ARCH_MESON




config TARGET_SHAKA
	bool "shaka s805"
    select CPU_V7
    select MACH_M8B
    select SUPPORT_SPL

config TARGET_TIMEBOX
	bool "timebox s812"
    select MACH_M8M2





config SYS_BOARD
	default "shaka" if TARGET_SHAKA
	default "timebox" if TARGET_TIMEBOX

config SYS_VENDOR
	default "fitdi"  if TARGET_SHAKA

config SYS_SOC
	default "meson" if TARGET_SHAKA
	default "meson" if TARGET_TIMEBOX

config SYS_CONFIG_NAME
	default "m8b" if TARGET_SHAKA
	default "m8" if TARGET_TIMEBOX


source "board/meson/Kconfig"
source "board/fitdi/shaka/Kconfig"

endif
```

## arch/arm/mach-rockchip/rk3128/Kconfig
```kconfig
if ROCKCHIP_RK3128

choice
	prompt "RK3128 board select"

config TARGET_EVB_RK3128
	bool "RK3128 evaluation board"
	select BOARD_LATE_INIT
	help
	  RK3128evb is a evaluation board for Rockchip rk3128,
	  with full function and phisical connectors support like
	  usb2.0 host ports, LVDS, JTAG, MAC, SDcard, HDMI, USB-2-serial...

config TARGET_TENAS_RK3128
	bool "RK3128 tenas board"
	select BOARD_LATE_INIT
	help
	  RK3128 tenas is a board for Rockchip rk3128,
	  with full function and phisical connectors support like
	  usb2.0 host ports, LVDS, JTAG, MAC, SDcard, HDMI, USB-2-serial...

endchoice

config SYS_SOC
	default "rockchip"

config SYS_MALLOC_F_LEN
	default 0x0800

source "board/rockchip/evb_rk3128/Kconfig"

source "board/rtavs/tenas_rk3128/Kconfig"

endif
```

## board/fitdi/shaka/Kconfig
```kconfig
if ARCH_MESON


if CONFIG_TARGET_SHAKA

config SYS_BOARD
	default "meson"


config SYS_CONFIG_NAME
	default "shaka"

config SYS_SOC
	default "meson"

endif


endif
```

## board/kmatt/mansa/Kconfig
```kconfig
if TARGET_MANSA_RK3288

config SYS_BOARD
	default "mansa"

config SYS_VENDOR
	default "kmatt"

config SYS_CONFIG_NAME
	default "mansa_rk3288"

config BOARD_SPECIFIC_OPTIONS # dummy
	def_bool y

endif
```

## board/meson/Kconfig
```kconfig
if ARCH_MESON

choice
	prompt "Meson SoC variant"
	optional

config MACH_M8B
	bool "Meson8b (Amlogic)"
	select CPU_V7
	select SUPPORT_SPL

endchoice

config SYS_BOARD
	default "meson"

config SYS_SOC
	default "meson"

config SYS_CONFIG_NAME
	default "m8b" if MACH_M8B

endif
```

## board/rtavs/menus_rk3288/Kconfig
```kconfig
if TARGET_MENUS_RK3288

config SYS_BOARD
	default "menus_rk3288"

config SYS_VENDOR
	default "rtavs"

config SYS_CONFIG_NAME
	default "menus_rk3288"

config BOARD_SPECIFIC_OPTIONS # dummy
	def_bool y

endif
```

## board/rtavs/tenas_rk3128/Kconfig
```kconfig
if TARGET_TENAS_RK3128

config SYS_BOARD
	default "tenas_rk3128"

config SYS_VENDOR
	default "rtavs"

config SYS_CONFIG_NAME
	default "tenas_rk3128"

config BOARD_SPECIFIC_OPTIONS # dummy
	def_bool y

endif
```

## board/rtavs/tunus_rk3288/Kconfig
```kconfig
if TARGET_TUNUS_RK3288

config SYS_BOARD
	default "tunus_rk3288"

config SYS_VENDOR
	default "rtavs"

config SYS_CONFIG_NAME
	default "tunus_rk3288"

config BOARD_SPECIFIC_OPTIONS # dummy
	def_bool y

endif
```

## configs/ec100_defconfig
```kconfig
CONFIG_ARM=y
CONFIG_SPL=y
CONFIG_ARCH_MESON=y
CONFIG_MACH_M8B=y
# CONFIG_CMD_IMLS is not set
```

## configs/shaka_defconfig
```kconfig
CONFIG_ARM=y
CONFIG_SPL=y
CONFIG_ARCH_MESON=y
CONFIG_MACH_MESON8B=y
CONFIG_MACH_M8B=y
CONFIG_TARGET_SHAKA=y
# CONFIG_CMD_IMLS is not set
# CONFIG_CMD_FLASH is not set
```
